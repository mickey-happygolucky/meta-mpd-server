## conf/layer.conf
```bitbake
# We have a conf and classes directory, append to BBPATH
BBPATH .= ":${LAYERDIR}"

# We have a recipes directory containing .bb and .bbappend files, add to BBFILES
BBFILES += "${LAYERDIR}/recipes*/*/*.bb \
            ${LAYERDIR}/recipes*/*/*.bbappend"

BBFILE_COLLECTIONS += "mpd-server"
BBFILE_PATTERN_mpd-server := "^${LAYERDIR}/"
BBFILE_PRIORITY_mpd-server = "10"

LAYERDEPENDS_mpd-server = "core"
```
